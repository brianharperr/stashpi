## br2-external/stashpi/Config.in
```kconfig
source "$BR2_EXTERNAL_STASHPI_PATH/package/libzim-stashpi/Config.in"
source "$BR2_EXTERNAL_STASHPI_PATH/package/libkiwix-stashpi/Config.in"
source "$BR2_EXTERNAL_STASHPI_PATH/package/kiwix-tools-stashpi/Config.in"
```

## br2-external/stashpi/package/kiwix-tools-stashpi/Config.in
```kconfig
config BR2_PACKAGE_KIWIX_TOOLS_STASHPI
	bool "kiwix-tools-stashpi"
	depends on BR2_INSTALL_LIBSTDCPP
	depends on BR2_TOOLCHAIN_HAS_THREADS
	select BR2_PACKAGE_LIBKIWIX_STASHPI
	select BR2_PACKAGE_LIBZIM_STASHPI
	select BR2_PACKAGE_DOCOPT_CPP
	help
	  kiwix-serve / kiwix-manage / kiwix-search command line tools,
	  built from the local kiwix-tools checkout against the
	  StashPi libkiwix/libzim.

	  https://github.com/kiwix/kiwix-tools
```

## br2-external/stashpi/package/libkiwix-stashpi/Config.in
```kconfig
config BR2_PACKAGE_LIBKIWIX_STASHPI
	bool "libkiwix-stashpi"
	depends on BR2_INSTALL_LIBSTDCPP
	depends on BR2_TOOLCHAIN_HAS_THREADS
	depends on BR2_USE_WCHAR
	select BR2_PACKAGE_LIBZIM_STASHPI
	select BR2_PACKAGE_ICU
	select BR2_PACKAGE_PUGIXML
	select BR2_PACKAGE_LIBCURL
	select BR2_PACKAGE_LIBMICROHTTPD
	select BR2_PACKAGE_ZLIB
	select BR2_PACKAGE_XAPIAN
	help
	  Kiwix server-side library (kiwix-serve, OPDS, search), built
	  from the StashPi fork at libkiwix_stashpi.

	  https://github.com/brianharperr/libkiwix_stashpi
```

## br2-external/stashpi/package/libzim-stashpi/Config.in
```kconfig
config BR2_PACKAGE_LIBZIM_STASHPI
	bool "libzim-stashpi"
	depends on BR2_INSTALL_LIBSTDCPP
	depends on BR2_TOOLCHAIN_HAS_THREADS
	depends on BR2_USE_WCHAR
	select BR2_PACKAGE_ZLIB
	select BR2_PACKAGE_XZ
	select BR2_PACKAGE_ZSTD
	select BR2_PACKAGE_XAPIAN
	select BR2_PACKAGE_ICU
	help
	  ZIM file reading/writing library, built from the local
	  StashPi checkout at deps/libzim.

	  https://github.com/openzim/libzim
```
